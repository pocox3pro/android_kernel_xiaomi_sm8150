## drivers/input/touchscreen/ndt_core/Kconfig
```kconfig
config INPUT_PRESS_NDT
	bool "ndt"
	depends on I2C
	help
	  Say Y here if you have a press ic ndt.
```

## drivers/input/touchscreen/spi_xiaomi_tp/Kconfig
```kconfig
config SPI_XIAOMI_TP
	bool
	depends on SPI
	help
	Say Y if want use xiaomi touch panel.
```
